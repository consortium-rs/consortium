// SPDX-License-Identifier: Apache-2.0

/dts-v1/;
/plugin/;

#include <dt-bindings/interrupt-controller/arm-gic.h>

/ {
    compatible = "st,stm32mp257f-dk";

    fragment@0 {
        target-path = "/";
        __overlay__ {
            /* UIO device for IPC shared memory + HSEM interrupt */
            consortium_uio0: consortium-uio@20060000 {
                compatible = "generic-uio";
                reg = <0x56240000 0x400>,            /* map0: HSEM */
                      <0x0A040000 0x20000>;          /* map1: regs */
                interrupts = <GIC_SPI 199 IRQ_TYPE_LEVEL_HIGH>;  /* SPI 199 → IRQ 231 */
                interrupt-names = "hsem";
                status = "okay";
                reg-names = "hsem", "regs";
            };
        };
    };
};
